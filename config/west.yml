## config/west.yml
```yaml
manifest:
  remotes:
    - name: zmkfirmware
      url-base: https://github.com/zmkfirmware
    - name: inorichi
      url-base: https://github.com/inorichi
    - name: keyfreaks
      url-base: https://github.com/kay-yokoyama
    - name: caksoylar
      url-base: https://github.com/caksoylar
    - name: prospector
      url-base: https://github.com/t-ogura
      
    - name: cormoran
      url-base: https://github.com/cormoran
      
#    - name: razilyis
#      url-base: https://github.com/razilyis


  projects:
#    - name: zmk
#      remote: zmkfirmware
#      revision: v0.2.1
#      import: app/west.yml

    - name: zmk
      remote: cormoran
#      revision: v0.3-branch+dya
      revision: e5c9b6915b56801193e359dd9bad4a167ce0d1b8
#      revision: main
      import: app/west.yml
      
#    - name: zmk
#      remote: zmkfirmware
#      revision: main
#      import: app/west.yml

    - name: zmk-pmw3610-driver
      remote: inorichi
      revision: main
    - name: zmk-rgbled-widget
      remote: caksoylar
      revision: v0.3-branch
    
#    - name: zmk-pmw3610-driver
#      remote: razilyis
#      revision: Dev-v0.3_inertial-scroll

# Add this:
    - name: prospector-zmk-module
      remote: prospector
      revision: v2.0.0  # Use v2.0.0 for ZMK ≤0.3 (Zephyr 3.x)
      path: modules/prospector-zmk-module
      
  self:
    path: config
```
